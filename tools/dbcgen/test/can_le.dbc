VERSION ""

NS_ :

BS_:

BU_: Panel Car

BO_ 256 driving_controls: 6 Panel
 SG_ gear : 34|3@1- (1,0) [-1|6] "" Vector__XXX,Car
 SG_ acceleration : 24|8@1+ (0.004,0) [0|1] "" Vector__XXX,Car
 SG_ brake : 17|8@1+ (0.004,0) [0|1] "" Vector__XXX,Car
 SG_ wheel : 1|16@1- (0.02,0) [-600|600] "degrees" Vector__XXX,Car

BO_ 272 engine: 4 Car
 SG_ temperature : 19|8@1- (0.5,35) [-50|150] "ºC" Vector__XXX,Panel
 SG_ rpm : 2|16@1+ (0.2,0) [0|13000] "rpm" Vector__XXX,Panel

BA_DEF_ SG_  "GenSigStartValue" INT -2147483648 2147483647;
BA_DEF_DEF_  "GenSigStartValue" 0;
BA_ "GenSigStartValue" SG_ 256 brake 250;
BA_ "GenSigStartValue" SG_ 256 gear 1;
BA_ "GenSigStartValue" SG_ 272 temperature -70;
BA_ "GenSigStartValue" SG_ 272 rpm 20000;
